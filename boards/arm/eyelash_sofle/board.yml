## boards/arm/eyelash_sofle/board.yml
```yaml
board:
  name: eyelash_sofle
  vendor: eyelashperipherals
  socs:
    - name: nrf52840
      variants:
        - name: qiaa
```

## boards/arm/eyelash_sofle_left/board.yml
```yaml
board:
  name: eyelash_sofle_left
  vendor: eyelashperipherals
  socs:
    - name: nrf52840
      variants:
        - name: qiaa
```

## boards/arm/eyelash_sofle_right/Kconfig.board
```kconfig
#
# Copyright (c) 2024 The ZMK Contributors
# SPDX-License-Identifier: MIT
#

config BOARD_EYELASH_SOFLE_RIGHT
    bool "eyelash_sofle right"
    select SOC_NRF52840_QIAA
```

## boards/arm/eyelash_sofle_right/board.yml
```yaml
board:
  name: eyelash_sofle_right
  vendor: eyelashperipherals
  socs:
    - name: nrf52840
      variants:
        - name: qiaa
```

## config/west.yml
```yaml
manifest:
  remotes:
    - name: zmkfirmware
      url-base: https://github.com/zmkfirmware
      # Additional modules containing boards/shields/custom code can be listed here as well.
      # See:
      # - https://zmk.dev/docs/features/modules
      # - https://docs.zephyrproject.org/3.5.0/develop/west/manifest.html#projects
    - name: gpeye
      url-base: https://github.com/GPeye
  projects:
    - name: eyelash_sofle
      url: https://github.com/a741725193/zmk-sofle
      revision: refactor
    - name: mario-peripheral-animation
      remote: gpeye
      revision: main
    - name: zmk
      remote: zmkfirmware
      # Testing commit from August 2024 - should have pointing support and be stable
      revision: 0b5a103c187ad337b9f50d824667866c4d7252e1
      import: app/west.yml
  self:
    path: config
```
